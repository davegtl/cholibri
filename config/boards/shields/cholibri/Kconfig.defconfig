## config/boards/shields/cholibri/Kconfig.defconfig
```kconfig
if SHIELD_CHOLIBRI_RIGHT

config ZMK_KEYBOARD_NAME
    default "Cholibri"

config ZMK_SPLIT_ROLE_CENTRAL
    default y

endif

if SHIELD_CHOLIBRI_LEFT || SHIELD_CHOLIBRI_RIGHT

config ZMK_SPLIT
    default y

endif

config I2C
    default y
```
